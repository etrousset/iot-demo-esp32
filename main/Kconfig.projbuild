## main/Kconfig.projbuild
```kconfig
menu "Kuzzle mqtt client sample"

config WIFI_SSID
    string "WiFi SSID"
	default "myssid"
	help
		SSID (network name) for the example to connect to.

config WIFI_PASSWORD
    string "WiFi Password"
	default "myssid"
	help
		WiFi password (WPA or WPA2) for the example to use.

		Can be left blank if the network has no security set.

config SERVER_IP
    string "HTTP Server IP"
	default "192.168.0.3"
	help
		HTTP Server IP to download the image file from.

		See example README.md for details.

config SERVER_PORT
	string "HTTP Server Port"
	default "8070"
	help
		HTTP Server port to connect to.
		Should be chosen not to conflict with any other port used
		on the system.

config FW_FILE
	string "Path to firmware binary file"
	default "firmware.bin"
	help
		Should be a file path such as it is reachable
		through http://SERVER_IP:SERVER_PORT/FW_FILE


endmenu
```
